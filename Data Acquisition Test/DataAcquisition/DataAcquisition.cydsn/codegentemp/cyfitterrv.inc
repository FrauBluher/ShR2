    IF :LNOT::DEF:INCLUDED_CYFITTERRV_INC
INCLUDED_CYFITTERRV_INC EQU 1
    GET cydevicerv.inc
    GET cydevicerv_trm.inc

; ADC_SAR_1_ADC_SAR
ADC_SAR_1_ADC_SAR__CLK EQU CYREG_SAR1_CLK
ADC_SAR_1_ADC_SAR__CSR0 EQU CYREG_SAR1_CSR0
ADC_SAR_1_ADC_SAR__CSR1 EQU CYREG_SAR1_CSR1
ADC_SAR_1_ADC_SAR__CSR2 EQU CYREG_SAR1_CSR2
ADC_SAR_1_ADC_SAR__CSR3 EQU CYREG_SAR1_CSR3
ADC_SAR_1_ADC_SAR__CSR4 EQU CYREG_SAR1_CSR4
ADC_SAR_1_ADC_SAR__CSR5 EQU CYREG_SAR1_CSR5
ADC_SAR_1_ADC_SAR__CSR6 EQU CYREG_SAR1_CSR6
ADC_SAR_1_ADC_SAR__PM_ACT_CFG EQU CYREG_PM_ACT_CFG11
ADC_SAR_1_ADC_SAR__PM_ACT_MSK EQU 0x02
ADC_SAR_1_ADC_SAR__PM_STBY_CFG EQU CYREG_PM_STBY_CFG11
ADC_SAR_1_ADC_SAR__PM_STBY_MSK EQU 0x02
ADC_SAR_1_ADC_SAR__SW0 EQU CYREG_SAR1_SW0
ADC_SAR_1_ADC_SAR__SW2 EQU CYREG_SAR1_SW2
ADC_SAR_1_ADC_SAR__SW3 EQU CYREG_SAR1_SW3
ADC_SAR_1_ADC_SAR__SW4 EQU CYREG_SAR1_SW4
ADC_SAR_1_ADC_SAR__SW6 EQU CYREG_SAR1_SW6
ADC_SAR_1_ADC_SAR__TR0 EQU CYREG_SAR1_TR0
ADC_SAR_1_ADC_SAR__WRK0 EQU CYREG_SAR1_WRK0
ADC_SAR_1_ADC_SAR__WRK1 EQU CYREG_SAR1_WRK1

; ADC_SAR_1_theACLK
ADC_SAR_1_theACLK__CFG0 EQU CYREG_CLKDIST_ACFG0_CFG0
ADC_SAR_1_theACLK__CFG1 EQU CYREG_CLKDIST_ACFG0_CFG1
ADC_SAR_1_theACLK__CFG2 EQU CYREG_CLKDIST_ACFG0_CFG2
ADC_SAR_1_theACLK__CFG2_SRC_SEL_MASK EQU 0x07
ADC_SAR_1_theACLK__CFG3 EQU CYREG_CLKDIST_ACFG0_CFG3
ADC_SAR_1_theACLK__CFG3_PHASE_DLY_MASK EQU 0x0F
ADC_SAR_1_theACLK__INDEX EQU 0x00
ADC_SAR_1_theACLK__PM_ACT_CFG EQU CYREG_PM_ACT_CFG1
ADC_SAR_1_theACLK__PM_ACT_MSK EQU 0x01
ADC_SAR_1_theACLK__PM_STBY_CFG EQU CYREG_PM_STBY_CFG1
ADC_SAR_1_theACLK__PM_STBY_MSK EQU 0x01

; ADC_SAR_1_Bypass
ADC_SAR_1_Bypass__0__MASK EQU 0x04
ADC_SAR_1_Bypass__0__PC EQU CYREG_PRT0_PC2
ADC_SAR_1_Bypass__0__PORT EQU 0
ADC_SAR_1_Bypass__0__SHIFT EQU 2
ADC_SAR_1_Bypass__AG EQU CYREG_PRT0_AG
ADC_SAR_1_Bypass__AMUX EQU CYREG_PRT0_AMUX
ADC_SAR_1_Bypass__BIE EQU CYREG_PRT0_BIE
ADC_SAR_1_Bypass__BIT_MASK EQU CYREG_PRT0_BIT_MASK
ADC_SAR_1_Bypass__BYP EQU CYREG_PRT0_BYP
ADC_SAR_1_Bypass__CTL EQU CYREG_PRT0_CTL
ADC_SAR_1_Bypass__DM0 EQU CYREG_PRT0_DM0
ADC_SAR_1_Bypass__DM1 EQU CYREG_PRT0_DM1
ADC_SAR_1_Bypass__DM2 EQU CYREG_PRT0_DM2
ADC_SAR_1_Bypass__DR EQU CYREG_PRT0_DR
ADC_SAR_1_Bypass__INP_DIS EQU CYREG_PRT0_INP_DIS
ADC_SAR_1_Bypass__LCD_COM_SEG EQU CYREG_PRT0_LCD_COM_SEG
ADC_SAR_1_Bypass__LCD_EN EQU CYREG_PRT0_LCD_EN
ADC_SAR_1_Bypass__MASK EQU 0x04
ADC_SAR_1_Bypass__PORT EQU 0
ADC_SAR_1_Bypass__PRT EQU CYREG_PRT0_PRT
ADC_SAR_1_Bypass__PRTDSI__CAPS_SEL EQU CYREG_PRT0_CAPS_SEL
ADC_SAR_1_Bypass__PRTDSI__DBL_SYNC_IN EQU CYREG_PRT0_DBL_SYNC_IN
ADC_SAR_1_Bypass__PRTDSI__OE_SEL0 EQU CYREG_PRT0_OE_SEL0
ADC_SAR_1_Bypass__PRTDSI__OE_SEL1 EQU CYREG_PRT0_OE_SEL1
ADC_SAR_1_Bypass__PRTDSI__OUT_SEL0 EQU CYREG_PRT0_OUT_SEL0
ADC_SAR_1_Bypass__PRTDSI__OUT_SEL1 EQU CYREG_PRT0_OUT_SEL1
ADC_SAR_1_Bypass__PRTDSI__SYNC_OUT EQU CYREG_PRT0_SYNC_OUT
ADC_SAR_1_Bypass__PS EQU CYREG_PRT0_PS
ADC_SAR_1_Bypass__SHIFT EQU 2
ADC_SAR_1_Bypass__SLW EQU CYREG_PRT0_SLW

; ADC_SAR_1_IRQ
ADC_SAR_1_IRQ__INTC_CLR_EN_REG EQU CYREG_NVIC_CLRENA0
ADC_SAR_1_IRQ__INTC_CLR_PD_REG EQU CYREG_NVIC_CLRPEND0
ADC_SAR_1_IRQ__INTC_MASK EQU 0x01
ADC_SAR_1_IRQ__INTC_NUMBER EQU 0
ADC_SAR_1_IRQ__INTC_PRIOR_NUM EQU 7
ADC_SAR_1_IRQ__INTC_PRIOR_REG EQU CYREG_NVIC_PRI_0
ADC_SAR_1_IRQ__INTC_SET_EN_REG EQU CYREG_NVIC_SETENA0
ADC_SAR_1_IRQ__INTC_SET_PD_REG EQU CYREG_NVIC_SETPEND0

; Miscellaneous
; -- WARNING: define names containing LEOPARD or PANTHER are deprecated and will be removed in a future release
CYDEV_DEBUGGING_DPS_SWD_SWV EQU 6
CYDEV_CONFIG_UNUSED_IO_AllowButWarn EQU 0
CYDEV_CONFIGURATION_MODE_COMPRESSED EQU 0
CYDEV_CONFIG_FASTBOOT_ENABLED EQU 1
CYDEV_CHIP_REV_PSOC5LP_PRODUCTION EQU 0
CYDEV_CHIP_REVISION_5B_PRODUCTION EQU 0
CYDEV_CHIP_MEMBER_5B EQU 4
CYDEV_CHIP_FAMILY_PSOC5 EQU 3
CYDEV_CHIP_DIE_PSOC5LP EQU 4
CYDEV_CHIP_DIE_EXPECT EQU CYDEV_CHIP_DIE_PSOC5LP
BCLK__BUS_CLK__HZ EQU 24000000
BCLK__BUS_CLK__KHZ EQU 24000
BCLK__BUS_CLK__MHZ EQU 24
CYDEV_CHIP_DIE_ACTUAL EQU CYDEV_CHIP_DIE_EXPECT
CYDEV_CHIP_DIE_LEOPARD EQU 1
CYDEV_CHIP_DIE_PANTHER EQU 3
CYDEV_CHIP_DIE_PSOC4A EQU 2
CYDEV_CHIP_DIE_UNKNOWN EQU 0
CYDEV_CHIP_FAMILY_PSOC3 EQU 1
CYDEV_CHIP_FAMILY_PSOC4 EQU 2
CYDEV_CHIP_FAMILY_UNKNOWN EQU 0
CYDEV_CHIP_FAMILY_USED EQU CYDEV_CHIP_FAMILY_PSOC5
CYDEV_CHIP_JTAG_ID EQU 0x2E123069
CYDEV_CHIP_MEMBER_3A EQU 1
CYDEV_CHIP_MEMBER_4A EQU 2
CYDEV_CHIP_MEMBER_5A EQU 3
CYDEV_CHIP_MEMBER_UNKNOWN EQU 0
CYDEV_CHIP_MEMBER_USED EQU CYDEV_CHIP_MEMBER_5B
CYDEV_CHIP_REVISION_3A_ES1 EQU 0
CYDEV_CHIP_REVISION_3A_ES2 EQU 1
CYDEV_CHIP_REVISION_3A_ES3 EQU 3
CYDEV_CHIP_REVISION_3A_PRODUCTION EQU 3
CYDEV_CHIP_REVISION_4A_ES0 EQU 17
CYDEV_CHIP_REVISION_4A_PRODUCTION EQU 17
CYDEV_CHIP_REVISION_5A_ES0 EQU 0
CYDEV_CHIP_REVISION_5A_ES1 EQU 1
CYDEV_CHIP_REVISION_5A_PRODUCTION EQU 1
CYDEV_CHIP_REVISION_5B_ES0 EQU 0
CYDEV_CHIP_REVISION_USED EQU CYDEV_CHIP_REVISION_5B_PRODUCTION
CYDEV_CHIP_REV_EXPECT EQU CYDEV_CHIP_REV_PSOC5LP_PRODUCTION
CYDEV_CHIP_REV_LEOPARD_ES1 EQU 0
CYDEV_CHIP_REV_LEOPARD_ES2 EQU 1
CYDEV_CHIP_REV_LEOPARD_ES3 EQU 3
CYDEV_CHIP_REV_LEOPARD_PRODUCTION EQU 3
CYDEV_CHIP_REV_PANTHER_ES0 EQU 0
CYDEV_CHIP_REV_PANTHER_ES1 EQU 1
CYDEV_CHIP_REV_PANTHER_PRODUCTION EQU 1
CYDEV_CHIP_REV_PSOC4A_ES0 EQU 17
CYDEV_CHIP_REV_PSOC4A_PRODUCTION EQU 17
CYDEV_CHIP_REV_PSOC5LP_ES0 EQU 0
CYDEV_CONFIGURATION_COMPRESSED EQU 1
CYDEV_CONFIGURATION_DMA EQU 0
CYDEV_CONFIGURATION_ECC EQU 1
CYDEV_CONFIGURATION_IMOENABLED EQU CYDEV_CONFIG_FASTBOOT_ENABLED
CYDEV_CONFIGURATION_MODE EQU CYDEV_CONFIGURATION_MODE_COMPRESSED
CYDEV_CONFIGURATION_MODE_DMA EQU 2
CYDEV_CONFIGURATION_MODE_UNCOMPRESSED EQU 1
CYDEV_CONFIG_UNUSED_IO EQU CYDEV_CONFIG_UNUSED_IO_AllowButWarn
CYDEV_CONFIG_UNUSED_IO_AllowWithInfo EQU 1
CYDEV_CONFIG_UNUSED_IO_Disallowed EQU 2
CYDEV_DEBUGGING_DPS EQU CYDEV_DEBUGGING_DPS_SWD_SWV
CYDEV_DEBUGGING_DPS_Disable EQU 3
CYDEV_DEBUGGING_DPS_JTAG_4 EQU 1
CYDEV_DEBUGGING_DPS_JTAG_5 EQU 0
CYDEV_DEBUGGING_DPS_SWD EQU 2
CYDEV_DEBUGGING_ENABLE EQU 1
CYDEV_DEBUGGING_XRES EQU 0
CYDEV_DEBUG_ENABLE_MASK EQU 0x20
CYDEV_DEBUG_ENABLE_REGISTER EQU CYREG_MLOGIC_DEBUG
CYDEV_DMA_CHANNELS_AVAILABLE EQU 24
CYDEV_ECC_ENABLE EQU 0
CYDEV_HEAP_SIZE EQU 0x1000
CYDEV_INSTRUCT_CACHE_ENABLED EQU 1
CYDEV_INTR_RISING EQU 0x00000001
CYDEV_PROJ_TYPE EQU 0
CYDEV_PROJ_TYPE_BOOTLOADER EQU 1
CYDEV_PROJ_TYPE_LOADABLE EQU 2
CYDEV_PROJ_TYPE_MULTIAPPBOOTLOADER EQU 3
CYDEV_PROJ_TYPE_STANDARD EQU 0
CYDEV_PROTECTION_ENABLE EQU 0
CYDEV_STACK_SIZE EQU 0x4000
CYDEV_USE_BUNDLED_CMSIS EQU 1
CYDEV_VARIABLE_VDDA EQU 0
CYDEV_VDDA_MV EQU 5000
CYDEV_VDDD_MV EQU 5000
CYDEV_VDDIO0_MV EQU 5000
CYDEV_VDDIO1_MV EQU 5000
CYDEV_VDDIO2_MV EQU 5000
CYDEV_VDDIO3_MV EQU 5000
CYDEV_VIO0 EQU 5
CYDEV_VIO0_MV EQU 5000
CYDEV_VIO1 EQU 5
CYDEV_VIO1_MV EQU 5000
CYDEV_VIO2 EQU 5
CYDEV_VIO2_MV EQU 5000
CYDEV_VIO3 EQU 5
CYDEV_VIO3_MV EQU 5000
DMA_CHANNELS_USED__MASK0 EQU 0x00000000
CYDEV_BOOTLOADER_ENABLE EQU 0
    ENDIF
    END
